VERSION ""

NS_ :

BS_:

BU_:
VAL_TABLE_ SYS_PORT_TABLE 23 " specific ECU defect 4" 22 " specific ECU defect 3" 21 " specific ECU defect 2" 20 "measure range out of range" 18 "the inhibition of a port" 16 "no signal is detected" 14 " wrong port configuration" 12 "unavailable port" 11 " specific ECU defect 1" 10 "system function calling" 9 "fault on power supply" 8 "unactivated power supply" 7 "hardware temperature limit" 6 "hardware voltage limit" 5 "hardware current limit" 4 "open circuit" 3 "short circuit to phase" 2 "short circuit to ground" 1 "hardware defec" 0 "undefined defect" ;

BO_ 486473856 DATA_POC_1: 8 Vector__XXX
 SG_ CSL_DIGIN_A2_LOGIC m0 : 16|16@1+ (1,0) [0|65535] "" Vector__XXX
 SG_ CSL_DIGIN_B4_LOGIC m0 : 32|16@1+ (1,0) [0|65535] "" Vector__XXX
 SG_ CSL_DIGIN_B1_FRQ m0 : 48|16@1+ (1,0) [0|65535] "" Vector__XXX
 SG_ CSL_DIGIN_Y32_FRQ m1 : 16|16@1+ (1,0) [0|65535] "" Vector__XXX
 SG_ CSL_DIGIN_Y35_LOGIC m1 : 32|16@1+ (1,0) [0|65535] "" Vector__XXX
 SG_ CSL_DIGIN_Y38_LOGIC m1 : 48|16@1+ (1,0) [0|65535] "" Vector__XXX
 SG_ CSL_DIGIN_Y28_FRQ m2 : 16|16@1+ (1,0) [0|65535] "" Vector__XXX
 SG_ CSL_DIGIN_Y26_FRQ m2 : 32|16@1+ (1,0) [0|65535] "" Vector__XXX
 SG_ CSL_DIGIN_Y44_LOGIC m2 : 48|16@1+ (1,0) [0|65535] "" Vector__XXX
 SG_ CSL_DIGIN_Y11_LOGIC m3 : 16|16@1+ (1,0) [0|65535] "" Vector__XXX
 SG_ CSL_DIGIN_H1_LOGIC m3 : 32|16@1+ (1,0) [0|65535] "" Vector__XXX
 SG_ CSL_DIGIN_K2_LOGIC m3 : 48|16@1+ (1,0) [0|65535] "" Vector__XXX
 SG_ CSL_DIGIN_G2_LOGIC m4 : 16|16@1+ (1,0) [0|65535] "" Vector__XXX
 SG_ CSL_DIGIN_D2_LOGIC m4 : 32|16@1+ (1,0) [0|65535] "" Vector__XXX
 SG_ CSL_DIGIN_Y50_LOGIC m4 : 48|16@1+ (1,0) [0|65535] "" Vector__XXX
 SG_ CSL_DIGIN_Y47_LOGIC m5 : 16|16@1+ (1,0) [0|65535] "" Vector__XXX
 SG_ CSL_DIGIN_Y19_LOGIC m5 : 32|16@1+ (1,0) [0|65535] "" Vector__XXX
 SG_ CSL_DIGIN_Y23_LOGIC m5 : 48|16@1+ (1,0) [0|65535] "" Vector__XXX
 SG_ CSL_DIGIN_Y24_FRQ m6 : 16|16@1+ (1,0) [0|65535] "" Vector__XXX
 SG_ CSL_DIGIN_Y7_LOGIC m6 : 32|16@1+ (1,0) [0|65535] "" Vector__XXX
 SG_ CSL_ANAIN_A4_LOGIC m6 : 48|16@1+ (1,0) [0|65535] "" Vector__XXX
 SG_ CSL_ANAIN_D4_FRQ m7 : 16|16@1+ (1,0) [0|65535] "" Vector__XXX
 SG_ CSL_ANAIN_G4_VOLT m7 : 32|16@1+ (1,0) [0|65535] "" Vector__XXX
 SG_ CSL_ANAIN_B3_VOLT m7 : 48|16@1+ (1,0) [0|65535] "" Vector__XXX
 SG_ CSL_ANAIN_C3_CURRENT m8 : 16|16@1+ (1,0) [0|65535] "" Vector__XXX
 SG_ CSL_ANAIN_D3_CURRENT m8 : 32|16@1+ (1,0) [0|65535] "" Vector__XXX
 SG_ CSL_ANAIN_E3_LOGIC m8 : 48|16@1+ (1,0) [0|65535] "" Vector__XXX
 SG_ CSL_ANAIN_F3_VOLT_PROMILLE m9 : 16|16@1+ (1,0) [0|65535] "" Vector__XXX
 SG_ CSL_ANAIN_Z7_LOGIC m9 : 32|16@1+ (1,0) [0|65535] "" Vector__XXX
 SG_ CSL_ANAIN_Z8_FRQ m9 : 48|16@1+ (1,0) [0|65535] "" Vector__XXX
 SG_ CSL_ANAIN_Z9_VOLT m10 : 16|16@1+ (1,0) [0|65535] "" Vector__XXX
 SG_ CSL_ANAIN_Z10_VOLT m10 : 32|16@1+ (1,0) [0|65535] "" Vector__XXX
 SG_ CSL_ANAIN_Z11_CURRENT m10 : 48|16@1+ (1,0) [0|65535] "" Vector__XXX
 SG_ CSL_ANAIN_Z12_CURRENT m11 : 16|16@1+ (1,0) [0|65535] "" Vector__XXX
 SG_ CSL_ANAIN_Z13_VOLT_PROMILLE m11 : 32|16@1+ (1,0) [0|65535] "" Vector__XXX
 SG_ CSL_ANAIN_Z14_VOLT_PROMILLE m11 : 48|16@1+ (1,0) [0|65535] "" Vector__XXX
 SG_ CSL_OUT_M3_DUTYCYCLE m12 : 16|16@1+ (1,0) [0|65535] "" Vector__XXX
 SG_ CSL_OUT_L1_DUTYCYCLE m12 : 32|16@1+ (1,0) [0|65535] "" Vector__XXX
 SG_ CSL_OUT_M4_DUTYCYCLE m12 : 48|16@1+ (1,0) [0|65535] "" Vector__XXX
 SG_ CSL_OUT_L4_DUTYCYCLE m13 : 16|16@1+ (1,0) [0|65535] "" Vector__XXX
 SG_ CSL_OUT_J2_DUTYCYCLE m13 : 32|16@1+ (1,0) [0|65535] "" Vector__XXX
 SG_ CSL_OUT_J3_DUTYCYCLE m13 : 48|16@1+ (1,0) [0|65535] "" Vector__XXX
 SG_ CSL_OUT_H3_DUTYCYCLE m14 : 16|16@1+ (1,0) [0|65535] "" Vector__XXX
 SG_ CSL_OUT_F1_DUTYCYCLE m14 : 32|16@1+ (1,0) [0|65535] "" Vector__XXX
 SG_ CSL_OUT_Y17_DUTYCYCLE m14 : 48|16@1+ (1,0) [0|65535] "" Vector__XXX
 SG_ CSL_OUT_Y41_DUTYCYCLE m15 : 16|16@1+ (1,0) [0|65535] "" Vector__XXX
 SG_ CSL_OUT_Y53_DUTYCYCLE m15 : 32|16@1+ (1,0) [0|65535] "" Vector__XXX
 SG_ CSL_OUT_Z42_C_SP_FREQ m15 : 48|16@1+ (1,0) [0|65535] "" Vector__XXX
 SG_ CSL_OUT_Z42_C_SP_DC m16 : 16|16@1+ (1,0) [0|65535] "" Vector__XXX
 SG_ CSL_OUT_Z42_C_FB_CURRENT m16 : 32|16@1+ (1,0) [0|65535] "" Vector__XXX
 SG_ CSL_OUT_Y22_DUTYCYCLE m16 : 48|16@1+ (1,0) [0|65535] "" Vector__XXX
 SG_ CSL_OUT_Y21_DUTYCYCLE m17 : 16|16@1+ (1,0) [0|65535] "" Vector__XXX
 SG_ CSL_OUT_Y20_DUTYCYCLE m17 : 32|16@1+ (1,0) [0|65535] "" Vector__XXX
 SG_ CSL_OUT_Y30_DUTYCYCLE m17 : 48|16@1+ (1,0) [0|65535] "" Vector__XXX
 SG_ CSL_OUT_G3_DUTYCYCLE m18 : 16|16@1+ (1,0) [0|65535] "" Vector__XXX
 SG_ CSL_OUT_K4_DUTYCYCLE m18 : 32|16@1+ (1,0) [0|65535] "" Vector__XXX
 SG_ CSL_OUT_K3_C_SP_FREQ m18 : 48|16@1+ (1,0) [0|65535] "" Vector__XXX
 SG_ CSL_OUT_K3_C_SP_DC m19 : 16|16@1+ (1,0) [0|65535] "" Vector__XXX
 SG_ CSL_OUT_K3_C_FB_CURRENT m19 : 32|16@1+ (1,0) [0|65535] "" Vector__XXX
 SG_ CSL_OUT_M1_C_SP_FREQ m19 : 48|16@1+ (1,0) [0|65535] "" Vector__XXX
 SG_ CSL_OUT_M1_C_SP_DC m20 : 16|16@1+ (1,0) [0|65535] "" Vector__XXX
 SG_ CSL_OUT_M1_C_FB_CURRENT m20 : 32|16@1+ (1,0) [0|65535] "" Vector__XXX
 SG_ CSL_OUT_Z51_DUTYCYCLE m20 : 48|16@1+ (1,0) [0|65535] "" Vector__XXX
 SG_ CSL_OUT_Z17_C_SP_FREQ m21 : 16|16@1+ (1,0) [0|65535] "" Vector__XXX
 SG_ CSL_OUT_Z17_C_SP_DC m21 : 32|16@1+ (1,0) [0|65535] "" Vector__XXX
 SG_ CSL_OUT_Z17_C_FB_CURRENT m21 : 48|16@1+ (1,0) [0|65535] "" Vector__XXX
 SG_ CSL_OUT_Z6_ACC_SP_FREQ m22 : 16|16@1+ (1,0) [0|65535] "" Vector__XXX
 SG_ CSL_OUT_Z6_ACC_SP_CURRENT m22 : 32|16@1+ (1,0) [0|65535] "" Vector__XXX
 SG_ CSL_OUT_Z6_ACC_FB_CURRENT m22 : 48|16@1+ (1,0) [0|65535] "" Vector__XXX
 SG_ CSL_OUT_Z30_ACC_SP_FREQ m23 : 16|16@1+ (1,0) [0|65535] "" Vector__XXX
 SG_ CSL_OUT_Z30_ACC_SP_CURRENT m23 : 32|16@1+ (1,0) [0|65535] "" Vector__XXX
 SG_ CSL_OUT_Z30_ACC_FB_CURRENT m23 : 48|16@1+ (1,0) [0|65535] "" Vector__XXX
 SG_ CSL_OUT_Z2_DUTYCYCLE m24 : 16|16@1+ (1,0) [0|65535] "" Vector__XXX
 SG_ CSL_OUT_Z3_DUTYCYCLE m24 : 32|16@1+ (1,0) [0|65535] "" Vector__XXX
 SG_ CSL_OUT_Z4_DUTYCYCLE m24 : 48|16@1+ (1,0) [0|65535] "" Vector__XXX
 SG_ CSL_OUT_Z5_DUTYCYCLE m25 : 16|16@1+ (1,0) [0|65535] "" Vector__XXX
 SG_ CSL_OUT_Y2_C_SP_FREQ m25 : 32|16@1+ (1,0) [0|65535] "" Vector__XXX
 SG_ CSL_OUT_Y2_C_SP_DC m25 : 48|16@1+ (1,0) [0|65535] "" Vector__XXX
 SG_ CSL_OUT_Y2_C_FB_CURRENT m26 : 16|16@1+ (1,0) [0|65535] "" Vector__XXX
 SG_ CSL_OUT_Y3_C_SP_FREQ m26 : 32|16@1+ (1,0) [0|65535] "" Vector__XXX
 SG_ CSL_OUT_Y3_C_SP_DC m26 : 48|16@1+ (1,0) [0|65535] "" Vector__XXX
 SG_ CSL_OUT_Y3_C_FB_CURRENT m27 : 16|16@1+ (1,0) [0|65535] "" Vector__XXX
 SG_ CSL_OUT_Y4_C_SP_FREQ m27 : 32|16@1+ (1,0) [0|65535] "" Vector__XXX
 SG_ CSL_OUT_Y4_C_SP_DC m27 : 48|16@1+ (1,0) [0|65535] "" Vector__XXX
 SG_ CSL_OUT_Y4_C_FB_CURRENT m28 : 16|16@1+ (1,0) [0|65535] "" Vector__XXX
 SG_ CSL_OUT_Y5_C_SP_FREQ m28 : 32|16@1+ (1,0) [0|65535] "" Vector__XXX
 SG_ CSL_OUT_Y5_C_SP_DC m28 : 48|16@1+ (1,0) [0|65535] "" Vector__XXX
 SG_ CSL_OUT_Y5_C_FB_CURRENT m29 : 16|16@1+ (1,0) [0|65535] "" Vector__XXX
 SG_ CSL_DIGIN_A2_DEEV m30 : 40|4@1+ (1,0) [0|255] "" Vector__XXX
 SG_ CSL_DIGIN_B4_DEEV m30 : 44|4@1+ (1,0) [0|255] "" Vector__XXX
 SG_ CSL_DIGIN_B1_DEEV m30 : 48|4@1+ (1,0) [0|255] "" Vector__XXX
 SG_ CSL_DIGIN_Y32_DEEV m30 : 52|4@1+ (1,0) [0|255] "" Vector__XXX
 SG_ CSL_DIGIN_Y35_DEEV m30 : 56|4@1+ (1,0) [0|255] "" Vector__XXX
 SG_ CSL_DIGIN_Y38_DEEV m30 : 60|4@1+ (1,0) [0|255] "" Vector__XXX
 SG_ CSL_DIGIN_Y28_DEEV m31 : 16|4@1+ (1,0) [0|255] "" Vector__XXX
 SG_ CSL_DIGIN_Y26_DEEV m31 : 20|4@1+ (1,0) [0|255] "" Vector__XXX
 SG_ CSL_DIGIN_Y44_DEEV m31 : 24|4@1+ (1,0) [0|255] "" Vector__XXX
 SG_ CSL_DIGIN_Y11_DEEV m31 : 28|4@1+ (1,0) [0|255] "" Vector__XXX
 SG_ CSL_DIGIN_H1_DEEV m31 : 32|4@1+ (1,0) [0|255] "" Vector__XXX
 SG_ CSL_DIGIN_K2_DEEV m31 : 36|4@1+ (1,0) [0|255] "" Vector__XXX
 SG_ CSL_DIGIN_G2_DEEV m31 : 40|4@1+ (1,0) [0|255] "" Vector__XXX
 SG_ CSL_DIGIN_D2_DEEV m31 : 44|4@1+ (1,0) [0|255] "" Vector__XXX
 SG_ CSL_DIGIN_Y50_DEEV m31 : 48|4@1+ (1,0) [0|255] "" Vector__XXX
 SG_ CSL_DIGIN_Y47_DEEV m31 : 52|4@1+ (1,0) [0|255] "" Vector__XXX
 SG_ CSL_DIGIN_Y19_DEEV m31 : 56|4@1+ (1,0) [0|255] "" Vector__XXX
 SG_ CSL_DIGIN_Y23_DEEV m31 : 60|4@1+ (1,0) [0|255] "" Vector__XXX
 SG_ CSL_DIGIN_Y24_DEEV m32 : 16|4@1+ (1,0) [0|255] "" Vector__XXX
 SG_ CSL_DIGIN_Y7_DEEV m32 : 20|4@1+ (1,0) [0|255] "" Vector__XXX
 SG_ CSL_ANAIN_A4_DEEV m32 : 24|4@1+ (1,0) [0|255] "" Vector__XXX
 SG_ CSL_ANAIN_D4_DEEV m32 : 28|4@1+ (1,0) [0|255] "" Vector__XXX
 SG_ CSL_ANAIN_G4_DEEV m32 : 32|4@1+ (1,0) [0|255] "" Vector__XXX
 SG_ CSL_ANAIN_B3_DEEV m32 : 36|4@1+ (1,0) [0|255] "" Vector__XXX
 SG_ CSL_ANAIN_C3_DEEV m32 : 40|4@1+ (1,0) [0|255] "" Vector__XXX
 SG_ CSL_ANAIN_D3_DEEV m32 : 44|4@1+ (1,0) [0|255] "" Vector__XXX
 SG_ CSL_ANAIN_E3_DEEV m32 : 48|4@1+ (1,0) [0|255] "" Vector__XXX
 SG_ CSL_ANAIN_F3_DEEV m32 : 52|4@1+ (1,0) [0|255] "" Vector__XXX
 SG_ CSL_ANAIN_Z7_DEEV m32 : 56|4@1+ (1,0) [0|255] "" Vector__XXX
 SG_ CSL_ANAIN_Z8_DEEV m32 : 60|4@1+ (1,0) [0|255] "" Vector__XXX
 SG_ CSL_ANAIN_Z9_DEEV m33 : 16|4@1+ (1,0) [0|255] "" Vector__XXX
 SG_ CSL_ANAIN_Z10_DEEV m33 : 20|4@1+ (1,0) [0|255] "" Vector__XXX
 SG_ CSL_ANAIN_Z11_DEEV m33 : 24|4@1+ (1,0) [0|255] "" Vector__XXX
 SG_ CSL_ANAIN_Z12_DEEV m33 : 28|4@1+ (1,0) [0|255] "" Vector__XXX
 SG_ CSL_ANAIN_Z13_DEEV m33 : 32|4@1+ (1,0) [0|255] "" Vector__XXX
 SG_ CSL_ANAIN_Z14_DEEV m33 : 36|4@1+ (1,0) [0|255] "" Vector__XXX
 SG_ CSL_OUT_M3_DEEV m33 : 40|4@1+ (1,0) [0|255] "" Vector__XXX
 SG_ CSL_OUT_L1_DEEV m33 : 44|4@1+ (1,0) [0|255] "" Vector__XXX
 SG_ CSL_OUT_M4_DEEV m33 : 48|4@1+ (1,0) [0|255] "" Vector__XXX
 SG_ CSL_OUT_L4_DEEV m33 : 52|4@1+ (1,0) [0|255] "" Vector__XXX
 SG_ CSL_OUT_J2_DEEV m33 : 56|4@1+ (1,0) [0|255] "" Vector__XXX
 SG_ CSL_OUT_J3_DEEV m33 : 60|4@1+ (1,0) [0|255] "" Vector__XXX
 SG_ CSL_OUT_H3_DEEV m34 : 16|4@1+ (1,0) [0|255] "" Vector__XXX
 SG_ CSL_OUT_F1_DEEV m34 : 20|4@1+ (1,0) [0|255] "" Vector__XXX
 SG_ CSL_OUT_Y17_DEEV m34 : 24|4@1+ (1,0) [0|255] "" Vector__XXX
 SG_ CSL_OUT_Y41_DEEV m34 : 28|4@1+ (1,0) [0|255] "" Vector__XXX
 SG_ CSL_OUT_Y53_DEEV m34 : 32|4@1+ (1,0) [0|255] "" Vector__XXX
 SG_ CSL_OUT_Z42_DEEV m34 : 36|4@1+ (1,0) [0|255] "" Vector__XXX
 SG_ CSL_OUT_Y22_DEEV m34 : 40|4@1+ (1,0) [0|255] "" Vector__XXX
 SG_ CSL_OUT_Y21_DEEV m34 : 44|4@1+ (1,0) [0|255] "" Vector__XXX
 SG_ CSL_OUT_Y20_DEEV m34 : 48|4@1+ (1,0) [0|255] "" Vector__XXX
 SG_ CSL_OUT_Y30_DEEV m34 : 52|4@1+ (1,0) [0|255] "" Vector__XXX
 SG_ CSL_OUT_G3_DEEV m34 : 56|4@1+ (1,0) [0|255] "" Vector__XXX
 SG_ CSL_OUT_K4_DEEV m34 : 60|4@1+ (1,0) [0|255] "" Vector__XXX
 SG_ CSL_OUT_K3_DEEV m35 : 16|4@1+ (1,0) [0|255] "" Vector__XXX
 SG_ CSL_OUT_M1_DEEV m35 : 20|4@1+ (1,0) [0|255] "" Vector__XXX
 SG_ CSL_OUT_Z51_DEEV m35 : 24|4@1+ (1,0) [0|255] "" Vector__XXX
 SG_ CSL_OUT_Z17_DEEV m35 : 28|4@1+ (1,0) [0|255] "" Vector__XXX
 SG_ CSL_OUT_Z6_DEEV m35 : 32|4@1+ (1,0) [0|255] "" Vector__XXX
 SG_ CSL_OUT_Z30_DEEV m35 : 36|4@1+ (1,0) [0|255] "" Vector__XXX
 SG_ CSL_OUT_Z2_DEEV m35 : 40|4@1+ (1,0) [0|255] "" Vector__XXX
 SG_ CSL_OUT_Z3_DEEV m35 : 44|4@1+ (1,0) [0|255] "" Vector__XXX
 SG_ CSL_OUT_Z4_DEEV m35 : 48|4@1+ (1,0) [0|255] "" Vector__XXX
 SG_ CSL_OUT_Z5_DEEV m35 : 52|4@1+ (1,0) [0|255] "" Vector__XXX
 SG_ CSL_OUT_Y2_DEEV m35 : 56|4@1+ (1,0) [0|255] "" Vector__XXX
 SG_ CSL_OUT_Y3_DEEV m35 : 60|4@1+ (1,0) [0|255] "" Vector__XXX
 SG_ CSL_OUT_Y4_DEEV m36 : 16|4@1+ (1,0) [0|255] "" Vector__XXX
 SG_ CSL_OUT_Y5_DEEV m36 : 20|4@1+ (1,0) [0|255] "" Vector__XXX
 SG_ CSL_DIGIN_A2_TITIM_MS m37 : 16|16@1+ (1,0) [0|65535] "" Vector__XXX
 SG_ CSL_DIGIN_A2_GATETIM_MS m37 : 32|16@1+ (1,0) [0|65535] "" Vector__XXX
 SG_ CSL_DIGIN_A2_DBCFILTTYPE m37 : 48|16@1+ (1,0) [0|65535] "" Vector__XXX
 SG_ CSL_DIGIN_A2_DBCFILTER_US m38 : 16|16@1+ (1,0) [0|65535] "" Vector__XXX
 SG_ CSL_DIGIN_B4_TITIM_MS m38 : 32|16@1+ (1,0) [0|65535] "" Vector__XXX
 SG_ CSL_DIGIN_B4_GATETIM_MS m38 : 48|16@1+ (1,0) [0|65535] "" Vector__XXX
 SG_ CSL_DIGIN_B4_DBCFILTTYPE m39 : 16|16@1+ (1,0) [0|65535] "" Vector__XXX
 SG_ CSL_DIGIN_B4_DBCFILTER_US m39 : 32|16@1+ (1,0) [0|65535] "" Vector__XXX
 SG_ CSL_DIGIN_B1_TITIM_MS m39 : 48|16@1+ (1,0) [0|65535] "" Vector__XXX
 SG_ CSL_DIGIN_B1_GATETIM_MS m40 : 16|16@1+ (1,0) [0|65535] "" Vector__XXX
 SG_ CSL_DIGIN_B1_DBCFILTTYPE m40 : 32|16@1+ (1,0) [0|65535] "" Vector__XXX
 SG_ CSL_DIGIN_B1_DBCFILTER_US m40 : 48|16@1+ (1,0) [0|65535] "" Vector__XXX
 SG_ CSL_DIGIN_Y32_TITIM_MS m41 : 16|16@1+ (1,0) [0|65535] "" Vector__XXX
 SG_ CSL_DIGIN_Y32_GATETIM_MS m41 : 32|16@1+ (1,0) [0|65535] "" Vector__XXX
 SG_ CSL_DIGIN_Y32_DBCFILTTYPE m41 : 48|16@1+ (1,0) [0|65535] "" Vector__XXX
 SG_ CSL_DIGIN_Y32_DBCFILTER_US m42 : 16|16@1+ (1,0) [0|65535] "" Vector__XXX
 SG_ CSL_DIGIN_Y35_TITIM_MS m42 : 32|16@1+ (1,0) [0|65535] "" Vector__XXX
 SG_ CSL_DIGIN_Y35_GATETIM_MS m42 : 48|16@1+ (1,0) [0|65535] "" Vector__XXX
 SG_ CSL_DIGIN_Y35_DBCFILTTYPE m43 : 16|16@1+ (1,0) [0|65535] "" Vector__XXX
 SG_ CSL_DIGIN_Y35_DBCFILTER_US m43 : 32|16@1+ (1,0) [0|65535] "" Vector__XXX
 SG_ CSL_DIGIN_Y38_TITIM_MS m43 : 48|16@1+ (1,0) [0|65535] "" Vector__XXX
 SG_ CSL_DIGIN_Y38_GATETIM_MS m44 : 16|16@1+ (1,0) [0|65535] "" Vector__XXX
 SG_ CSL_DIGIN_Y38_DBCFILTTYPE m44 : 32|16@1+ (1,0) [0|65535] "" Vector__XXX
 SG_ CSL_DIGIN_Y38_DBCFILTER_US m44 : 48|16@1+ (1,0) [0|65535] "" Vector__XXX
 SG_ CSL_DIGIN_Y28_TITIM_MS m45 : 16|16@1+ (1,0) [0|65535] "" Vector__XXX
 SG_ CSL_DIGIN_Y28_GATETIM_MS m45 : 32|16@1+ (1,0) [0|65535] "" Vector__XXX
 SG_ CSL_DIGIN_Y28_DBCFILTTYPE m45 : 48|16@1+ (1,0) [0|65535] "" Vector__XXX
 SG_ CSL_DIGIN_Y28_DBCFILTER_US m46 : 16|16@1+ (1,0) [0|65535] "" Vector__XXX
 SG_ CSL_DIGIN_Y26_TITIM_MS m46 : 32|16@1+ (1,0) [0|65535] "" Vector__XXX
 SG_ CSL_DIGIN_Y26_GATETIM_MS m46 : 48|16@1+ (1,0) [0|65535] "" Vector__XXX
 SG_ CSL_DIGIN_Y26_DBCFILTTYPE m47 : 16|16@1+ (1,0) [0|65535] "" Vector__XXX
 SG_ CSL_DIGIN_Y26_DBCFILTER_US m47 : 32|16@1+ (1,0) [0|65535] "" Vector__XXX
 SG_ CSL_DIGIN_Y44_TITIM_MS m47 : 48|16@1+ (1,0) [0|65535] "" Vector__XXX
 SG_ CSL_DIGIN_Y44_GATETIM_MS m48 : 16|16@1+ (1,0) [0|65535] "" Vector__XXX
 SG_ CSL_DIGIN_Y44_DBCFILTTYPE m48 : 32|16@1+ (1,0) [0|65535] "" Vector__XXX
 SG_ CSL_DIGIN_Y44_DBCFILTER_US m48 : 48|16@1+ (1,0) [0|65535] "" Vector__XXX
 SG_ CSL_DIGIN_Y11_TITIM_MS m49 : 16|16@1+ (1,0) [0|65535] "" Vector__XXX
 SG_ CSL_DIGIN_Y11_GATETIM_MS m49 : 32|16@1+ (1,0) [0|65535] "" Vector__XXX
 SG_ CSL_DIGIN_Y11_DBCFILTTYPE m49 : 48|16@1+ (1,0) [0|65535] "" Vector__XXX
 SG_ CSL_DIGIN_Y11_DBCFILTER_US m50 : 16|16@1+ (1,0) [0|65535] "" Vector__XXX
 SG_ CSL_DIGIN_H1_TITIM_MS m50 : 32|16@1+ (1,0) [0|65535] "" Vector__XXX
 SG_ CSL_DIGIN_H1_GATETIM_MS m50 : 48|16@1+ (1,0) [0|65535] "" Vector__XXX
 SG_ CSL_DIGIN_H1_DBCFILTTYPE m51 : 16|16@1+ (1,0) [0|65535] "" Vector__XXX
 SG_ CSL_DIGIN_H1_DBCFILTER_US m51 : 32|16@1+ (1,0) [0|65535] "" Vector__XXX
 SG_ CSL_DIGIN_K2_TITIM_MS m51 : 48|16@1+ (1,0) [0|65535] "" Vector__XXX
 SG_ CSL_DIGIN_K2_GATETIM_MS m52 : 16|16@1+ (1,0) [0|65535] "" Vector__XXX
 SG_ CSL_DIGIN_K2_DBCFILTTYPE m52 : 32|16@1+ (1,0) [0|65535] "" Vector__XXX
 SG_ CSL_DIGIN_K2_DBCFILTER_US m52 : 48|16@1+ (1,0) [0|65535] "" Vector__XXX
 SG_ CSL_DIGIN_G2_TITIM_MS m53 : 16|16@1+ (1,0) [0|65535] "" Vector__XXX
 SG_ CSL_DIGIN_G2_GATETIM_MS m53 : 32|16@1+ (1,0) [0|65535] "" Vector__XXX
 SG_ CSL_DIGIN_G2_DBCFILTTYPE m53 : 48|16@1+ (1,0) [0|65535] "" Vector__XXX
 SG_ CSL_DIGIN_G2_DBCFILTER_US m54 : 16|16@1+ (1,0) [0|65535] "" Vector__XXX
 SG_ CSL_DIGIN_D2_TITIM_MS m54 : 32|16@1+ (1,0) [0|65535] "" Vector__XXX
 SG_ CSL_DIGIN_D2_GATETIM_MS m54 : 48|16@1+ (1,0) [0|65535] "" Vector__XXX
 SG_ CSL_DIGIN_D2_DBCFILTTYPE m55 : 16|16@1+ (1,0) [0|65535] "" Vector__XXX
 SG_ CSL_DIGIN_D2_DBCFILTER_US m55 : 32|16@1+ (1,0) [0|65535] "" Vector__XXX
 SG_ CSL_DIGIN_Y50_TITIM_MS m55 : 48|16@1+ (1,0) [0|65535] "" Vector__XXX
 SG_ CSL_DIGIN_Y50_GATETIM_MS m56 : 16|16@1+ (1,0) [0|65535] "" Vector__XXX
 SG_ CSL_DIGIN_Y50_DBCFILTTYPE m56 : 32|16@1+ (1,0) [0|65535] "" Vector__XXX
 SG_ CSL_DIGIN_Y50_DBCFILTER_US m56 : 48|16@1+ (1,0) [0|65535] "" Vector__XXX
 SG_ CSL_DIGIN_Y47_TITIM_MS m57 : 16|16@1+ (1,0) [0|65535] "" Vector__XXX
 SG_ CSL_DIGIN_Y47_GATETIM_MS m57 : 32|16@1+ (1,0) [0|65535] "" Vector__XXX
 SG_ CSL_DIGIN_Y47_DBCFILTTYPE m57 : 48|16@1+ (1,0) [0|65535] "" Vector__XXX
 SG_ CSL_DIGIN_Y47_DBCFILTER_US m58 : 16|16@1+ (1,0) [0|65535] "" Vector__XXX
 SG_ CSL_DIGIN_Y19_TITIM_MS m58 : 32|16@1+ (1,0) [0|65535] "" Vector__XXX
 SG_ CSL_DIGIN_Y19_GATETIM_MS m58 : 48|16@1+ (1,0) [0|65535] "" Vector__XXX
 SG_ CSL_DIGIN_Y19_DBCFILTTYPE m59 : 16|16@1+ (1,0) [0|65535] "" Vector__XXX
 SG_ CSL_DIGIN_Y19_DBCFILTER_US m59 : 32|16@1+ (1,0) [0|65535] "" Vector__XXX
 SG_ CSL_DIGIN_Y23_TITIM_MS m59 : 48|16@1+ (1,0) [0|65535] "" Vector__XXX
 SG_ CSL_DIGIN_Y23_GATETIM_MS m60 : 16|16@1+ (1,0) [0|65535] "" Vector__XXX
 SG_ CSL_DIGIN_Y23_DBCFILTTYPE m60 : 32|16@1+ (1,0) [0|65535] "" Vector__XXX
 SG_ CSL_DIGIN_Y23_DBCFILTER_US m60 : 48|16@1+ (1,0) [0|65535] "" Vector__XXX
 SG_ CSL_DIGIN_Y24_TITIM_MS m61 : 16|16@1+ (1,0) [0|65535] "" Vector__XXX
 SG_ CSL_DIGIN_Y24_GATETIM_MS m61 : 32|16@1+ (1,0) [0|65535] "" Vector__XXX
 SG_ CSL_DIGIN_Y24_DBCFILTTYPE m61 : 48|16@1+ (1,0) [0|65535] "" Vector__XXX
 SG_ CSL_DIGIN_Y24_DBCFILTER_US m62 : 16|16@1+ (1,0) [0|65535] "" Vector__XXX
 SG_ CSL_DIGIN_Y7_TITIM_MS m62 : 32|16@1+ (1,0) [0|65535] "" Vector__XXX
 SG_ CSL_DIGIN_Y7_GATETIM_MS m62 : 48|16@1+ (1,0) [0|65535] "" Vector__XXX
 SG_ CSL_DIGIN_Y7_DBCFILTTYPE m63 : 16|16@1+ (1,0) [0|65535] "" Vector__XXX
 SG_ CSL_DIGIN_Y7_DBCFILTER_US m63 : 32|16@1+ (1,0) [0|65535] "" Vector__XXX
 SG_ CSL_ANAIN_A4_TITIM_MS m63 : 48|16@1+ (1,0) [0|65535] "" Vector__XXX
 SG_ CSL_ANAIN_A4_GATETIM_MS m64 : 16|16@1+ (1,0) [0|65535] "" Vector__XXX
 SG_ CSL_ANAIN_A4_DBCFILTTYPE m64 : 32|16@1+ (1,0) [0|65535] "" Vector__XXX
 SG_ CSL_ANAIN_A4_DBCFILTER_US m64 : 48|16@1+ (1,0) [0|65535] "ddd" Vector__XXX
 SG_ CSL_ANAIN_D4_TITIM_MS m65 : 16|16@1+ (1,0) [0|65535] "" Vector__XXX
 SG_ CSL_ANAIN_D4_GATETIM_MS m65 : 32|16@1+ (1,0) [0|65535] "" Vector__XXX
 SG_ CSL_ANAIN_D4_DBCFILTTYPE m65 : 48|16@1+ (1,0) [0|65535] "" Vector__XXX
 SG_ CSL_ANAIN_D4_DBCFILTER_US m66 : 16|16@1+ (1,0) [0|65535] "" Vector__XXX
 SG_ CSL_ANAIN_G4_SAMPL_RATE m66 : 32|16@1+ (1,0) [0|65535] "" Vector__XXX
 SG_ CSL_ANAIN_G4_AVRG_SAMPL m66 : 48|16@1+ (1,0) [0|65535] "" Vector__XXX
 SG_ CSL_ANAIN_B3_SAMPL_RATE m67 : 16|16@1+ (1,0) [0|65535] "" Vector__XXX
 SG_ CSL_ANAIN_B3_AVRG_SAMPL m67 : 32|16@1+ (1,0) [0|65535] "" Vector__XXX
 SG_ CSL_ANAIN_C3_SAMPL_RATE m67 : 48|16@1+ (1,0) [0|65535] "" Vector__XXX
 SG_ CSL_ANAIN_C3_AVRG_SAMPL m68 : 16|16@1+ (1,0) [0|65535] "" Vector__XXX
 SG_ CSL_ANAIN_D3_SAMPL_RATE m68 : 32|16@1+ (1,0) [0|65535] "" Vector__XXX
 SG_ CSL_ANAIN_D3_AVRG_SAMPL m68 : 48|16@1+ (1,0) [0|65535] "" Vector__XXX
 SG_ CSL_ANAIN_E3_TITIM_MS m69 : 16|16@1+ (1,0) [0|65535] "" Vector__XXX
 SG_ CSL_ANAIN_E3_GATETIM_MS m69 : 32|16@1+ (1,0) [0|65535] "" Vector__XXX
 SG_ CSL_ANAIN_E3_DBCFILTTYPE m69 : 48|16@1+ (1,0) [0|65535] "" Vector__XXX
 SG_ CSL_ANAIN_E3_DBCFILTER_US m70 : 16|16@1+ (1,0) [0|65535] "" Vector__XXX
 SG_ CSL_ANAIN_F3_SAMPL_RATE m70 : 32|16@1+ (1,0) [0|65535] "" Vector__XXX
 SG_ CSL_ANAIN_F3_AVRG_SAMPL m70 : 48|16@1+ (1,0) [0|65535] "" Vector__XXX
 SG_ CSL_ANAIN_Z7_TITIM_MS m71 : 16|16@1+ (1,0) [0|65535] "" Vector__XXX
 SG_ CSL_ANAIN_Z7_GATETIM_MS m71 : 32|16@1+ (1,0) [0|65535] "" Vector__XXX
 SG_ CSL_ANAIN_Z7_DBCFILTTYPE m71 : 48|16@1+ (1,0) [0|65535] "" Vector__XXX
 SG_ CSL_ANAIN_Z7_DBCFILTER_US m72 : 16|16@1+ (1,0) [0|65535] "" Vector__XXX
 SG_ CSL_ANAIN_Z8_TITIM_MS m72 : 32|16@1+ (1,0) [0|65535] "" Vector__XXX
 SG_ CSL_ANAIN_Z8_GATETIM_MS m72 : 48|16@1+ (1,0) [0|65535] "" Vector__XXX
 SG_ CSL_ANAIN_Z8_DBCFILTTYPE m73 : 16|16@1+ (1,0) [0|65535] "" Vector__XXX
 SG_ CSL_ANAIN_Z8_DBCFILTER_US m73 : 32|16@1+ (1,0) [0|65535] "" Vector__XXX
 SG_ CSL_ANAIN_Z9_SAMPL_RATE m73 : 48|16@1+ (1,0) [0|65535] "" Vector__XXX
 SG_ CSL_ANAIN_Z9_AVRG_SAMPL m74 : 16|16@1+ (1,0) [0|65535] "" Vector__XXX
 SG_ CSL_ANAIN_Z10_SAMPL_RATE m74 : 32|16@1+ (1,0) [0|65535] "" Vector__XXX
 SG_ CSL_ANAIN_Z10_AVRG_SAMPL m74 : 48|16@1+ (1,0) [0|65535] "" Vector__XXX
 SG_ CSL_ANAIN_Z11_SAMPL_RATE m75 : 16|16@1+ (1,0) [0|65535] "" Vector__XXX
 SG_ CSL_ANAIN_Z11_AVRG_SAMPL m75 : 32|16@1+ (1,0) [0|65535] "" Vector__XXX
 SG_ CSL_ANAIN_Z12_SAMPL_RATE m75 : 48|16@1+ (1,0) [0|65535] "" Vector__XXX
 SG_ CSL_ANAIN_Z12_AVRG_SAMPL m76 : 16|16@1+ (1,0) [0|65535] "" Vector__XXX
 SG_ CSL_ANAIN_Z13_SAMPL_RATE m76 : 32|16@1+ (1,0) [0|65535] "" Vector__XXX
 SG_ CSL_ANAIN_Z13_AVRG_SAMPL m76 : 48|16@1+ (1,0) [0|65535] "" Vector__XXX
 SG_ CSL_ANAIN_Z14_SAMPL_RATE m77 : 16|16@1+ (1,0) [0|65535] "" Vector__XXX
 SG_ CSL_ANAIN_Z14_AVRG_SAMPL m77 : 32|16@1+ (1,0) [0|65535] "" Vector__XXX
 SG_ CSL_OUT_M3_FREQ_HZ m77 : 48|16@1+ (1,0) [0|65535] "" Vector__XXX
 SG_ CSL_OUT_M3_CURRLIM_MA m78 : 16|16@1+ (1,0) [0|65535] "" Vector__XXX
 SG_ CSL_OUT_M3_OVERCURRTIM_MS m78 : 32|16@1+ (1,0) [0|65535] "" Vector__XXX
 SG_ CSL_OUT_M3_OC_DETECT m78 : 48|16@1+ (1,0) [0|65535] "" Vector__XXX
 SG_ CSL_OUT_M3_DITHFREQ_HZ m79 : 16|16@1+ (1,0) [0|65535] "" Vector__XXX
 SG_ CSL_OUT_M3_DITHAMPL_HZ m79 : 32|16@1+ (1,0) [0|65535] "" Vector__XXX
 SG_ CSL_OUT_M3_LOAD_TYPE m79 : 48|16@1+ (1,0) [0|65535] "" Vector__XXX
 SG_ CSL_OUT_L1_FREQ_HZ m80 : 16|16@1+ (1,0) [0|65535] "" Vector__XXX
 SG_ CSL_OUT_L1_CURRLIM_MA m80 : 32|16@1+ (1,0) [0|65535] "" Vector__XXX
 SG_ CSL_OUT_L1_OVERCURRTIM_MS m80 : 48|16@1+ (1,0) [0|65535] "" Vector__XXX
 SG_ CSL_OUT_L1_OC_DETECT m81 : 16|16@1+ (1,0) [0|65535] "" Vector__XXX
 SG_ CSL_OUT_L1_DITHFREQ_HZ m81 : 32|16@1+ (1,0) [0|65535] "" Vector__XXX
 SG_ CSL_OUT_L1_DITHAMPL_HZ m81 : 48|16@1+ (1,0) [0|65535] "" Vector__XXX
 SG_ CSL_OUT_L1_LOAD_TYPE m82 : 16|16@1+ (1,0) [0|65535] "" Vector__XXX
 SG_ CSL_OUT_M4_FREQ_HZ m82 : 32|16@1+ (1,0) [0|65535] "" Vector__XXX
 SG_ CSL_OUT_M4_CURRLIM_MA m82 : 48|16@1+ (1,0) [0|65535] "" Vector__XXX
 SG_ CSL_OUT_M4_OVERCURRTIM_MS m83 : 16|16@1+ (1,0) [0|65535] "" Vector__XXX
 SG_ CSL_OUT_M4_OC_DETECT m83 : 32|16@1+ (1,0) [0|65535] "" Vector__XXX
 SG_ CSL_OUT_M4_DITHFREQ_HZ m83 : 48|16@1+ (1,0) [0|65535] "" Vector__XXX
 SG_ CSL_OUT_M4_DITHAMPL_HZ m84 : 16|16@1+ (1,0) [0|65535] "" Vector__XXX
 SG_ CSL_OUT_M4_LOAD_TYPE m84 : 32|16@1+ (1,0) [0|65535] "" Vector__XXX
 SG_ CSL_OUT_L4_FREQ_HZ m84 : 48|16@1+ (1,0) [0|65535] "" Vector__XXX
 SG_ CSL_OUT_L4_CURRLIM_MA m85 : 16|16@1+ (1,0) [0|65535] "" Vector__XXX
 SG_ CSL_OUT_L4_OVERCURRTIM_MS m85 : 32|16@1+ (1,0) [0|65535] "" Vector__XXX
 SG_ CSL_OUT_L4_OC_DETECT m85 : 48|16@1+ (1,0) [0|65535] "" Vector__XXX
 SG_ CSL_OUT_L4_DITHFREQ_HZ m86 : 16|16@1+ (1,0) [0|65535] "" Vector__XXX
 SG_ CSL_OUT_L4_DITHAMPL_HZ m86 : 32|16@1+ (1,0) [0|65535] "" Vector__XXX
 SG_ CSL_OUT_L4_LOAD_TYPE m86 : 48|16@1+ (1,0) [0|65535] "" Vector__XXX
 SG_ CSL_OUT_J2_FREQ_HZ m87 : 16|16@1+ (1,0) [0|65535] "" Vector__XXX
 SG_ CSL_OUT_J2_CURRLIM_MA m87 : 32|16@1+ (1,0) [0|65535] "" Vector__XXX
 SG_ CSL_OUT_J2_OVERCURRTIM_MS m87 : 48|16@1+ (1,0) [0|65535] "" Vector__XXX
 SG_ CSL_OUT_J2_OC_DETECT m88 : 16|16@1+ (1,0) [0|65535] "" Vector__XXX
 SG_ CSL_OUT_J2_DITHFREQ_HZ m88 : 32|16@1+ (1,0) [0|65535] "" Vector__XXX
 SG_ CSL_OUT_J2_DITHAMPL_HZ m88 : 48|16@1+ (1,0) [0|65535] "" Vector__XXX
 SG_ CSL_OUT_J2_LOAD_TYPE m89 : 16|16@1+ (1,0) [0|65535] "" Vector__XXX
 SG_ CSL_OUT_J3_FREQ_HZ m89 : 32|16@1+ (1,0) [0|65535] "" Vector__XXX
 SG_ CSL_OUT_J3_CURRLIM_MA m89 : 48|16@1+ (1,0) [0|65535] "" Vector__XXX
 SG_ CSL_OUT_J3_OVERCURRTIM_MS m90 : 16|16@1+ (1,0) [0|65535] "" Vector__XXX
 SG_ CSL_OUT_J3_OC_DETECT m90 : 32|16@1+ (1,0) [0|65535] "" Vector__XXX
 SG_ CSL_OUT_J3_DITHFREQ_HZ m90 : 48|16@1+ (1,0) [0|65535] "" Vector__XXX
 SG_ CSL_OUT_J3_DITHAMPL_HZ m91 : 16|16@1+ (1,0) [0|65535] "" Vector__XXX
 SG_ CSL_OUT_J3_LOAD_TYPE m91 : 32|16@1+ (1,0) [0|65535] "" Vector__XXX
 SG_ CSL_OUT_H3_FREQ_HZ m91 : 48|16@1+ (1,0) [0|65535] "" Vector__XXX
 SG_ CSL_OUT_H3_CURRLIM_MA m92 : 16|16@1+ (1,0) [0|65535] "" Vector__XXX
 SG_ CSL_OUT_H3_OVERCURRTIM_MS m92 : 32|16@1+ (1,0) [0|65535] "" Vector__XXX
 SG_ CSL_OUT_H3_OC_DETECT m92 : 48|16@1+ (1,0) [0|65535] "" Vector__XXX
 SG_ CSL_OUT_H3_DITHFREQ_HZ m93 : 16|16@1+ (1,0) [0|65535] "" Vector__XXX
 SG_ CSL_OUT_H3_DITHAMPL_HZ m93 : 32|16@1+ (1,0) [0|65535] "" Vector__XXX
 SG_ CSL_OUT_H3_LOAD_TYPE m93 : 48|16@1+ (1,0) [0|65535] "" Vector__XXX
 SG_ CSL_OUT_F1_FREQ_HZ m94 : 16|16@1+ (1,0) [0|65535] "" Vector__XXX
 SG_ CSL_OUT_F1_CURRLIM_MA m94 : 32|16@1+ (1,0) [0|65535] "" Vector__XXX
 SG_ CSL_OUT_F1_OVERCURRTIM_MS m94 : 48|16@1+ (1,0) [0|65535] "" Vector__XXX
 SG_ CSL_OUT_F1_OC_DETECT m95 : 16|16@1+ (1,0) [0|65535] "" Vector__XXX
 SG_ CSL_OUT_F1_DITHFREQ_HZ m95 : 32|16@1+ (1,0) [0|65535] "" Vector__XXX
 SG_ CSL_OUT_F1_DITHAMPL_HZ m95 : 48|16@1+ (1,0) [0|65535] "" Vector__XXX
 SG_ CSL_OUT_F1_LOAD_TYPE m96 : 16|16@1+ (1,0) [0|65535] "" Vector__XXX
 SG_ CSL_OUT_Y17_FREQ_HZ m96 : 32|16@1+ (1,0) [0|65535] "" Vector__XXX
 SG_ CSL_OUT_Y17_CURRLIM_MA m96 : 48|16@1+ (1,0) [0|65535] "" Vector__XXX
 SG_ CSL_OUT_Y17_OVERCURRTIM_MS m97 : 16|16@1+ (1,0) [0|65535] "" Vector__XXX
 SG_ CSL_OUT_Y17_OC_DETECT m97 : 32|16@1+ (1,0) [0|65535] "" Vector__XXX
 SG_ CSL_OUT_Y17_DITHFREQ_HZ m97 : 48|16@1+ (1,0) [0|65535] "" Vector__XXX
 SG_ CSL_OUT_Y17_DITHAMPL_HZ m98 : 16|16@1+ (1,0) [0|65535] "" Vector__XXX
 SG_ CSL_OUT_Y17_LOAD_TYPE m98 : 32|16@1+ (1,0) [0|65535] "" Vector__XXX
 SG_ CSL_OUT_Y41_FREQ_HZ m98 : 48|16@1+ (1,0) [0|65535] "" Vector__XXX
 SG_ CSL_OUT_Y41_CURRLIM_MA m99 : 16|16@1+ (1,0) [0|65535] "" Vector__XXX
 SG_ CSL_OUT_Y41_OVERCURRTIM_MS m99 : 32|16@1+ (1,0) [0|65535] "" Vector__XXX
 SG_ CSL_OUT_Y41_OC_DETECT m99 : 48|16@1+ (1,0) [0|65535] "" Vector__XXX
 SG_ CSL_OUT_Y41_DITHFREQ_HZ m100 : 16|16@1+ (1,0) [0|65535] "" Vector__XXX
 SG_ CSL_OUT_Y41_DITHAMPL_HZ m100 : 32|16@1+ (1,0) [0|65535] "" Vector__XXX
 SG_ CSL_OUT_Y41_LOAD_TYPE m100 : 48|16@1+ (1,0) [0|65535] "" Vector__XXX
 SG_ CSL_OUT_Y53_FREQ_HZ m101 : 16|16@1+ (1,0) [0|65535] "" Vector__XXX
 SG_ CSL_OUT_Y53_CURRLIM_MA m101 : 32|16@1+ (1,0) [0|65535] "" Vector__XXX
 SG_ CSL_OUT_Y53_OVERCURRTIM_MS m101 : 48|16@1+ (1,0) [0|65535] "" Vector__XXX
 SG_ CSL_OUT_Y53_OC_DETECT m102 : 16|16@1+ (1,0) [0|65535] "" Vector__XXX
 SG_ CSL_OUT_Y53_DITHFREQ_HZ m102 : 32|16@1+ (1,0) [0|65535] "" Vector__XXX
 SG_ CSL_OUT_Y53_DITHAMPL_HZ m102 : 48|16@1+ (1,0) [0|65535] "" Vector__XXX
 SG_ CSL_OUT_Y53_LOAD_TYPE m103 : 16|16@1+ (1,0) [0|65535] "" Vector__XXX
 SG_ CSL_OUT_Z42_FREQ_HZ m103 : 32|16@1+ (1,0) [0|65535] "" Vector__XXX
 SG_ CSL_OUT_Z42_CURRLIM_MA m103 : 48|16@1+ (1,0) [0|65535] "" Vector__XXX
 SG_ CSL_OUT_Z42_OVERCURRTIM_MS m104 : 16|16@1+ (1,0) [0|65535] "" Vector__XXX
 SG_ CSL_OUT_Z42_OC_DETECT m104 : 32|16@1+ (1,0) [0|65535] "" Vector__XXX
 SG_ CSL_OUT_Z42_DITHFREQ_HZ m104 : 48|16@1+ (1,0) [0|65535] "" Vector__XXX
 SG_ CSL_OUT_Z42_DITHAMPL_HZ m105 : 16|16@1+ (1,0) [0|65535] "" Vector__XXX
 SG_ CSL_OUT_Z42_LOAD_TYPE m105 : 32|16@1+ (1,0) [0|65535] "" Vector__XXX
 SG_ CSL_OUT_Y22_FREQ_HZ m105 : 48|16@1+ (1,0) [0|65535] "" Vector__XXX
 SG_ CSL_OUT_Y22_CURRLIM_MA m106 : 16|16@1+ (1,0) [0|65535] "" Vector__XXX
 SG_ CSL_OUT_Y22_OVERCURRTIM_MS m106 : 32|16@1+ (1,0) [0|65535] "" Vector__XXX
 SG_ CSL_OUT_Y22_OC_DETECT m106 : 48|16@1+ (1,0) [0|65535] "" Vector__XXX
 SG_ CSL_OUT_Y22_DITHFREQ_HZ m107 : 16|16@1+ (1,0) [0|65535] "" Vector__XXX
 SG_ CSL_OUT_Y22_DITHAMPL_HZ m107 : 32|16@1+ (1,0) [0|65535] "" Vector__XXX
 SG_ CSL_OUT_Y22_LOAD_TYPE m107 : 48|16@1+ (1,0) [0|65535] "" Vector__XXX
 SG_ CSL_OUT_Y21_FREQ_HZ m108 : 16|16@1+ (1,0) [0|65535] "" Vector__XXX
 SG_ CSL_OUT_Y21_CURRLIM_MA m108 : 32|16@1+ (1,0) [0|65535] "" Vector__XXX
 SG_ CSL_OUT_Y21_OVERCURRTIM_MS m108 : 48|16@1+ (1,0) [0|65535] "" Vector__XXX
 SG_ CSL_OUT_Y21_OC_DETECT m109 : 16|16@1+ (1,0) [0|65535] "" Vector__XXX
 SG_ CSL_OUT_Y21_DITHFREQ_HZ m109 : 32|16@1+ (1,0) [0|65535] "" Vector__XXX
 SG_ CSL_OUT_Y21_DITHAMPL_HZ m109 : 48|16@1+ (1,0) [0|65535] "" Vector__XXX
 SG_ CSL_OUT_Y21_LOAD_TYPE m110 : 16|16@1+ (1,0) [0|65535] "" Vector__XXX
 SG_ CSL_OUT_Y20_FREQ_HZ m110 : 32|16@1+ (1,0) [0|65535] "" Vector__XXX
 SG_ CSL_OUT_Y20_CURRLIM_MA m110 : 48|16@1+ (1,0) [0|65535] "" Vector__XXX
 SG_ CSL_OUT_Y20_OVERCURRTIM_MS m111 : 16|16@1+ (1,0) [0|65535] "" Vector__XXX
 SG_ CSL_OUT_Y20_OC_DETECT m111 : 32|16@1+ (1,0) [0|65535] "" Vector__XXX
 SG_ CSL_OUT_Y20_DITHFREQ_HZ m111 : 48|16@1+ (1,0) [0|65535] "" Vector__XXX
 SG_ CSL_OUT_Y20_DITHAMPL_HZ m112 : 16|16@1+ (1,0) [0|65535] "" Vector__XXX
 SG_ CSL_OUT_Y20_LOAD_TYPE m112 : 32|16@1+ (1,0) [0|65535] "" Vector__XXX
 SG_ CSL_OUT_Y30_FREQ_HZ m112 : 48|16@1+ (1,0) [0|65535] "" Vector__XXX
 SG_ CSL_OUT_Y30_CURRLIM_MA m113 : 16|16@1+ (1,0) [0|65535] "" Vector__XXX
 SG_ CSL_OUT_Y30_OVERCURRTIM_MS m113 : 32|16@1+ (1,0) [0|65535] "" Vector__XXX
 SG_ CSL_OUT_Y30_OC_DETECT m113 : 48|16@1+ (1,0) [0|65535] "" Vector__XXX
 SG_ CSL_OUT_Y30_DITHFREQ_HZ m114 : 16|16@1+ (1,0) [0|65535] "" Vector__XXX
 SG_ CSL_OUT_Y30_DITHAMPL_HZ m114 : 32|16@1+ (1,0) [0|65535] "" Vector__XXX
 SG_ CSL_OUT_Y30_LOAD_TYPE m114 : 48|16@1+ (1,0) [0|65535] "" Vector__XXX
 SG_ CSL_OUT_G3_FREQ_HZ m115 : 16|16@1+ (1,0) [0|65535] "" Vector__XXX
 SG_ CSL_OUT_G3_CURRLIM_MA m115 : 32|16@1+ (1,0) [0|65535] "" Vector__XXX
 SG_ CSL_OUT_G3_OVERCURRTIM_MS m115 : 48|16@1+ (1,0) [0|65535] "" Vector__XXX
 SG_ CSL_OUT_G3_OC_DETECT m116 : 16|16@1+ (1,0) [0|65535] "" Vector__XXX
 SG_ CSL_OUT_G3_DITHFREQ_HZ m116 : 32|16@1+ (1,0) [0|65535] "" Vector__XXX
 SG_ CSL_OUT_G3_DITHAMPL_HZ m116 : 48|16@1+ (1,0) [0|65535] "" Vector__XXX
 SG_ CSL_OUT_G3_LOAD_TYPE m117 : 16|16@1+ (1,0) [0|65535] "" Vector__XXX
 SG_ CSL_OUT_K4_FREQ_HZ m117 : 32|16@1+ (1,0) [0|65535] "" Vector__XXX
 SG_ CSL_OUT_K4_CURRLIM_MA m117 : 48|16@1+ (1,0) [0|65535] "" Vector__XXX
 SG_ CSL_OUT_K4_OVERCURRTIM_MS m118 : 16|16@1+ (1,0) [0|65535] "" Vector__XXX
 SG_ CSL_OUT_K4_OC_DETECT m118 : 32|16@1+ (1,0) [0|65535] "" Vector__XXX
 SG_ CSL_OUT_K4_DITHFREQ_HZ m118 : 48|16@1+ (1,0) [0|65535] "" Vector__XXX
 SG_ CSL_OUT_K4_DITHAMPL_HZ m119 : 16|16@1+ (1,0) [0|65535] "" Vector__XXX
 SG_ CSL_OUT_K4_LOAD_TYPE m119 : 32|16@1+ (1,0) [0|65535] "" Vector__XXX
 SG_ CSL_OUT_K3_FREQ_HZ m119 : 48|16@1+ (1,0) [0|65535] "" Vector__XXX
 SG_ CSL_OUT_K3_CURRLIM_MA m120 : 16|16@1+ (1,0) [0|65535] "" Vector__XXX
 SG_ CSL_OUT_K3_OVERCURRTIM_MS m120 : 32|16@1+ (1,0) [0|65535] "" Vector__XXX
 SG_ CSL_OUT_K3_OC_DETECT m120 : 48|16@1+ (1,0) [0|65535] "" Vector__XXX
 SG_ CSL_OUT_K3_DITHFREQ_HZ m121 : 16|16@1+ (1,0) [0|65535] "" Vector__XXX
 SG_ CSL_OUT_K3_DITHAMPL_HZ m121 : 32|16@1+ (1,0) [0|65535] "" Vector__XXX
 SG_ CSL_OUT_K3_LOAD_TYPE m121 : 48|16@1+ (1,0) [0|65535] "" Vector__XXX
 SG_ CSL_OUT_M1_FREQ_HZ m122 : 16|16@1+ (1,0) [0|65535] "" Vector__XXX
 SG_ CSL_OUT_M1_CURRLIM_MA m122 : 32|16@1+ (1,0) [0|65535] "" Vector__XXX
 SG_ CSL_OUT_M1_OVERCURRTIM_MS m122 : 48|16@1+ (1,0) [0|65535] "" Vector__XXX
 SG_ CSL_OUT_M1_OC_DETECT m123 : 16|16@1+ (1,0) [0|65535] "" Vector__XXX
 SG_ CSL_OUT_M1_DITHFREQ_HZ m123 : 32|16@1+ (1,0) [0|65535] "" Vector__XXX
 SG_ CSL_OUT_M1_DITHAMPL_HZ m123 : 48|16@1+ (1,0) [0|65535] "" Vector__XXX
 SG_ CSL_OUT_M1_LOAD_TYPE m124 : 16|16@1+ (1,0) [0|65535] "" Vector__XXX
 SG_ CSL_OUT_Z51_FREQ_HZ m124 : 32|16@1+ (1,0) [0|65535] "" Vector__XXX
 SG_ CSL_OUT_Z51_CURRLIM_MA m124 : 48|16@1+ (1,0) [0|65535] "" Vector__XXX
 SG_ CSL_OUT_Z51_OVERCURRTIM_MS m125 : 16|16@1+ (1,0) [0|65535] "" Vector__XXX
 SG_ CSL_OUT_Z51_OC_DETECT m125 : 32|16@1+ (1,0) [0|65535] "" Vector__XXX
 SG_ CSL_OUT_Z51_DITHFREQ_HZ m125 : 48|16@1+ (1,0) [0|65535] "" Vector__XXX
 SG_ CSL_OUT_Z51_DITHAMPL_HZ m126 : 16|16@1+ (1,0) [0|65535] "" Vector__XXX
 SG_ CSL_OUT_Z51_LOAD_TYPE m126 : 32|16@1+ (1,0) [0|65535] "" Vector__XXX
 SG_ CSL_OUT_Z17_FREQ_HZ m126 : 48|16@1+ (1,0) [0|65535] "" Vector__XXX
 SG_ CSL_OUT_Z17_CURRLIM_MA m127 : 16|16@1+ (1,0) [0|65535] "" Vector__XXX
 SG_ CSL_OUT_Z17_OVERCURRTIM_MS m127 : 32|16@1+ (1,0) [0|65535] "" Vector__XXX
 SG_ CSL_OUT_Z17_OC_DETECT m127 : 48|16@1+ (1,0) [0|65535] "" Vector__XXX
 SG_ CSL_OUT_Z17_DITHFREQ_HZ m128 : 16|16@1+ (1,0) [0|65535] "" Vector__XXX
 SG_ CSL_OUT_Z17_DITHAMPL_HZ m128 : 32|16@1+ (1,0) [0|65535] "" Vector__XXX
 SG_ CSL_OUT_Z17_LOAD_TYPE m128 : 48|16@1+ (1,0) [0|65535] "" Vector__XXX
 SG_ CSL_OUT_Z6_FREQ_HZ m129 : 16|16@1+ (1,0) [0|65535] "" Vector__XXX
 SG_ CSL_OUT_Z6_LOAD_TYPE m129 : 32|16@1+ (1,0) [0|65535] "" Vector__XXX
 SG_ CSL_OUT_Z6_CURRLIM_MA m129 : 48|16@1+ (1,0) [0|65535] "" Vector__XXX
 SG_ CSL_OUT_Z6_OVERCURRTIM_MS m130 : 16|16@1+ (1,0) [0|65535] "" Vector__XXX
 SG_ CSL_OUT_Z6_OC_DETECT m130 : 32|16@1+ (1,0) [0|65535] "" Vector__XXX
 SG_ CSL_OUT_Z6_DITHFREQ_HZ m130 : 48|16@1+ (1,0) [0|65535] "" Vector__XXX
 SG_ CSL_OUT_Z6_DITHAMPL_HZ m131 : 16|16@1+ (1,0) [0|65535] "" Vector__XXX
 SG_ CSL_OUT_Z6_CCO_P m131 : 32|16@1+ (1,0) [0|65535] "" Vector__XXX
 SG_ CSL_OUT_Z6_CCO_I m131 : 48|16@1+ (1,0) [0|65535] "" Vector__XXX
 SG_ CSL_OUT_Z6_CCO_D m132 : 16|16@1+ (1,0) [0|65535] "" Vector__XXX
 SG_ CSL_OUT_Z30_FREQ_HZ m132 : 32|16@1+ (1,0) [0|65535] "" Vector__XXX
 SG_ CSL_OUT_Z30_LOAD_TYPE m132 : 48|16@1+ (1,0) [0|65535] "" Vector__XXX
 SG_ CSL_OUT_Z30_CURRLIM_MA m133 : 16|16@1+ (1,0) [0|65535] "" Vector__XXX
 SG_ CSL_OUT_Z30_OVERCURRTIM_MS m133 : 32|16@1+ (1,0) [0|65535] "" Vector__XXX
 SG_ CSL_OUT_Z30_OC_DETECT m133 : 48|16@1+ (1,0) [0|65535] "" Vector__XXX
 SG_ CSL_OUT_Z30_DITHFREQ_HZ m134 : 16|16@1+ (1,0) [0|65535] "" Vector__XXX
 SG_ CSL_OUT_Z30_DITHAMPL_HZ m134 : 32|16@1+ (1,0) [0|65535] "" Vector__XXX
 SG_ CSL_OUT_Z30_CCO_P m134 : 48|16@1+ (1,0) [0|65535] "" Vector__XXX
 SG_ CSL_OUT_Z30_CCO_I m135 : 16|16@1+ (1,0) [0|65535] "" Vector__XXX
 SG_ CSL_OUT_Z30_CCO_D m135 : 32|16@1+ (1,0) [0|65535] "" Vector__XXX
 SG_ CSL_OUT_Z2_FREQ_HZ m135 : 48|16@1+ (1,0) [0|65535] "" Vector__XXX
 SG_ CSL_OUT_Z2_CURRLIM_MA m136 : 16|16@1+ (1,0) [0|65535] "" Vector__XXX
 SG_ CSL_OUT_Z2_OVERCURRTIM_MS m136 : 32|16@1+ (1,0) [0|65535] "" Vector__XXX
 SG_ CSL_OUT_Z2_OC_DETECT m136 : 48|16@1+ (1,0) [0|65535] "" Vector__XXX
 SG_ CSL_OUT_Z2_DITHFREQ_HZ m137 : 16|16@1+ (1,0) [0|65535] "" Vector__XXX
 SG_ CSL_OUT_Z2_DITHAMPL_HZ m137 : 32|16@1+ (1,0) [0|65535] "" Vector__XXX
 SG_ CSL_OUT_Z2_LOAD_TYPE m137 : 48|16@1+ (1,0) [0|65535] "" Vector__XXX
 SG_ CSL_OUT_Z3_FREQ_HZ m138 : 16|16@1+ (1,0) [0|65535] "" Vector__XXX
 SG_ CSL_OUT_Z3_CURRLIM_MA m138 : 32|16@1+ (1,0) [0|65535] "" Vector__XXX
 SG_ CSL_OUT_Z3_OVERCURRTIM_MS m138 : 48|16@1+ (1,0) [0|65535] "" Vector__XXX
 SG_ CSL_OUT_Z3_OC_DETECT m139 : 16|16@1+ (1,0) [0|65535] "" Vector__XXX
 SG_ CSL_OUT_Z3_DITHFREQ_HZ m139 : 32|16@1+ (1,0) [0|65535] "" Vector__XXX
 SG_ CSL_OUT_Z3_DITHAMPL_HZ m139 : 48|16@1+ (1,0) [0|65535] "" Vector__XXX
 SG_ CSL_OUT_Z3_LOAD_TYPE m140 : 16|16@1+ (1,0) [0|65535] "" Vector__XXX
 SG_ CSL_OUT_Z4_FREQ_HZ m140 : 32|16@1+ (1,0) [0|65535] "" Vector__XXX
 SG_ CSL_OUT_Z4_CURRLIM_MA m140 : 48|16@1+ (1,0) [0|65535] "" Vector__XXX
 SG_ CSL_OUT_Z4_OVERCURRTIM_MS m141 : 16|16@1+ (1,0) [0|65535] "" Vector__XXX
 SG_ CSL_OUT_Z4_OC_DETECT m141 : 32|16@1+ (1,0) [0|65535] "" Vector__XXX
 SG_ CSL_OUT_Z4_DITHFREQ_HZ m141 : 48|16@1+ (1,0) [0|65535] "" Vector__XXX
 SG_ CSL_OUT_Z4_DITHAMPL_HZ m142 : 16|16@1+ (1,0) [0|65535] "" Vector__XXX
 SG_ CSL_OUT_Z4_LOAD_TYPE m142 : 32|16@1+ (1,0) [0|65535] "" Vector__XXX
 SG_ CSL_OUT_Z5_FREQ_HZ m142 : 48|16@1+ (1,0) [0|65535] "" Vector__XXX
 SG_ CSL_OUT_Z5_CURRLIM_MA m143 : 16|16@1+ (1,0) [0|65535] "" Vector__XXX
 SG_ CSL_OUT_Z5_OVERCURRTIM_MS m143 : 32|16@1+ (1,0) [0|65535] "" Vector__XXX
 SG_ CSL_OUT_Z5_OC_DETECT m143 : 48|16@1+ (1,0) [0|65535] "" Vector__XXX
 SG_ CSL_OUT_Z5_DITHFREQ_HZ m144 : 16|16@1+ (1,0) [0|65535] "" Vector__XXX
 SG_ CSL_OUT_Z5_DITHAMPL_HZ m144 : 32|16@1+ (1,0) [0|65535] "" Vector__XXX
 SG_ CSL_OUT_Z5_LOAD_TYPE m144 : 48|16@1+ (1,0) [0|65535] "" Vector__XXX
 SG_ CSL_OUT_Y2_FREQ_HZ m145 : 16|16@1+ (1,0) [0|65535] "" Vector__XXX
 SG_ CSL_OUT_Y2_CURRLIM_MA m145 : 32|16@1+ (1,0) [0|65535] "" Vector__XXX
 SG_ CSL_OUT_Y2_OVERCURRTIM_MS m145 : 48|16@1+ (1,0) [0|65535] "" Vector__XXX
 SG_ CSL_OUT_Y2_OC_DETECT m146 : 16|16@1+ (1,0) [0|65535] "" Vector__XXX
 SG_ CSL_OUT_Y2_DITHFREQ_HZ m146 : 32|16@1+ (1,0) [0|65535] "" Vector__XXX
 SG_ CSL_OUT_Y2_DITHAMPL_HZ m146 : 48|16@1+ (1,0) [0|65535] "" Vector__XXX
 SG_ CSL_OUT_Y2_LOAD_TYPE m147 : 16|16@1+ (1,0) [0|65535] "" Vector__XXX
 SG_ CSL_OUT_Y3_FREQ_HZ m147 : 32|16@1+ (1,0) [0|65535] "" Vector__XXX
 SG_ CSL_OUT_Y3_CURRLIM_MA m147 : 48|16@1+ (1,0) [0|65535] "" Vector__XXX
 SG_ CSL_OUT_Y3_OVERCURRTIM_MS m148 : 16|16@1+ (1,0) [0|65535] "" Vector__XXX
 SG_ CSL_OUT_Y3_OC_DETECT m148 : 32|16@1+ (1,0) [0|65535] "" Vector__XXX
 SG_ CSL_OUT_Y3_DITHFREQ_HZ m148 : 48|16@1+ (1,0) [0|65535] "" Vector__XXX
 SG_ CSL_OUT_Y3_DITHAMPL_HZ m149 : 16|16@1+ (1,0) [0|65535] "" Vector__XXX
 SG_ CSL_OUT_Y3_LOAD_TYPE m149 : 32|16@1+ (1,0) [0|65535] "" Vector__XXX
 SG_ CSL_OUT_Y4_FREQ_HZ m149 : 48|16@1+ (1,0) [0|65535] "" Vector__XXX
 SG_ CSL_OUT_Y4_CURRLIM_MA m150 : 16|16@1+ (1,0) [0|65535] "" Vector__XXX
 SG_ CSL_OUT_Y4_OVERCURRTIM_MS m150 : 32|16@1+ (1,0) [0|65535] "" Vector__XXX
 SG_ CSL_OUT_Y4_OC_DETECT m150 : 48|16@1+ (1,0) [0|65535] "" Vector__XXX
 SG_ CSL_OUT_Y4_DITHFREQ_HZ m151 : 16|16@1+ (1,0) [0|65535] "" Vector__XXX
 SG_ CSL_OUT_Y4_DITHAMPL_HZ m151 : 32|16@1+ (1,0) [0|65535] "" Vector__XXX
 SG_ CSL_OUT_Y4_LOAD_TYPE m151 : 48|16@1+ (1,0) [0|65535] "" Vector__XXX
 SG_ CSL_OUT_Y5_FREQ_HZ m152 : 16|16@1+ (1,0) [0|65535] "" Vector__XXX
 SG_ CSL_OUT_Y5_CURRLIM_MA m152 : 32|16@1+ (1,0) [0|65535] "" Vector__XXX
 SG_ CSL_OUT_Y5_OVERCURRTIM_MS m152 : 48|16@1+ (1,0) [0|65535] "" Vector__XXX
 SG_ CSL_OUT_Y5_OC_DETECT m153 : 16|16@1+ (1,0) [0|65535] "" Vector__XXX
 SG_ CSL_OUT_Y5_DITHFREQ_HZ m153 : 32|16@1+ (1,0) [0|65535] "" Vector__XXX
 SG_ CSL_OUT_Y5_DITHAMPL_HZ m153 : 48|16@1+ (1,0) [0|65535] "" Vector__XXX
 SG_ CSL_OUT_Y5_LOAD_TYPE m154 : 16|16@1+ (1,0) [0|65535] "" Vector__XXX
 SG_ MULTIPLEXER M : 0|12@1+ (1,0) [0|0] "" Vector__XXX

CM_ SG_ 2633957504 CSL_ANAIN_A4_DBCFILTER_US "gfnbdgg";
BA_DEF_ SG_  "SigType" ENUM  "Default","Range","RangeSigned","ASCII","Discrete","Control","ReferencePGN","DTC","StringDelimiter","StringLength","StringLengthControl","MessageCounter","MessageChecksum";
BA_DEF_ SG_  "GenSigEVName" STRING ;
BA_DEF_ SG_  "GenSigILSupport" ENUM  "No","Yes";
BA_DEF_ SG_  "GenSigSendType" ENUM  "Cyclic","OnWrite","OnWriteWithRepetition","OnChange","OnChangeWithRepetition","IfActive","IfActiveWithRepetition","NoSigSendType";
BA_DEF_ BO_  "GenMsgILSupport" ENUM  "No","Yes";
BA_DEF_ BU_  "NmStationAddress" INT 0 255;
BA_DEF_ BO_  "GenMsgSendType" ENUM  "cyclic","NotUsed","IfActive","NotUsed","NotUsed","NotUsed","NotUsed","NotUsed","noMsgSendType";
BA_DEF_ BO_  "GenMsgRequestable" INT 0 1;
BA_DEF_ BO_  "GenMsgCycleTime" INT 0 3600000;
BA_DEF_  "DBName" STRING ;
BA_DEF_  "BusType" STRING ;
BA_DEF_  "ProtocolType" STRING ;
BA_DEF_ BO_  "VFrameFormat" ENUM  "StandardCAN","ExtendedCAN","reserved","J1939PG";
BA_DEF_DEF_  "SigType" "Default";
BA_DEF_DEF_  "GenSigEVName" "Env@Nodename_@Signame";
BA_DEF_DEF_  "GenSigILSupport" "Yes";
BA_DEF_DEF_  "GenSigSendType" "NoSigSendType";
BA_DEF_DEF_  "GenMsgILSupport" "Yes";
BA_DEF_DEF_  "NmStationAddress" 254;
BA_DEF_DEF_  "GenMsgSendType" "noMsgSendType";
BA_DEF_DEF_  "GenMsgRequestable" 1;
BA_DEF_DEF_  "GenMsgCycleTime" 0;
BA_DEF_DEF_  "DBName" "";
BA_DEF_DEF_  "BusType" "CAN";
BA_DEF_DEF_  "ProtocolType" "J1939";
BA_DEF_DEF_  "VFrameFormat" "J1939PG";
BA_ "DBName" "Baling_Process";
BA_ "GenMsgILSupport" BO_ 2633957504 0;
BA_ "GenMsgCycleTime" BO_ 2633957504 100;
BA_ "GenMsgSendType" BO_ 2633957504 0;
VAL_ 2633957504 CSL_ANAIN_A4_DBCFILTER_US 23 " specific ECU defect 4" 22 " specific ECU defect 3" 21 " specific ECU defect 2" 20 "measure range out of range" 18 "the inhibition of a port" 16 "no signal is detected" 14 " wrong port configuration" 12 "unavailable port" 11 " specific ECU defect 1" 10 "system function calling" 9 "fault on power supply" 8 "unactivated power supply" 7 "hardware temperature limit" 6 "hardware voltage limit" 5 "hardware current limit" 4 "open circuit" 3 "short circuit to phase" 2 "short circuit to ground" 1 "hardware defec" 0 "undefined defect" ;
VAL_ 2633957504 CSL_ANAIN_D4_DBCFILTTYPE 23 " specific ECU defect 4" 22 " specific ECU defect 3" 21 " specific ECU defect 2" 20 "measure range out of range" 18 "the inhibition of a port" 16 "no signal is detected" 14 " wrong port configuration" 12 "unavailable port" 11 " specific ECU defect 1" 10 "system function calling" 9 "fault on power supply" 8 "unactivated power supply" 7 "hardware temperature limit" 6 "hardware voltage limit" 5 "hardware current limit" 4 "open circuit" 3 "short circuit to phase" 2 "short circuit to ground" 1 "hardware defec" 0 "undefined defect" ;
